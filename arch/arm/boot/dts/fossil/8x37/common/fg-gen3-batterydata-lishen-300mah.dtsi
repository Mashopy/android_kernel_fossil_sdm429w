
qcom,4917649_300mah_averaged_masterslave_jan5th2021 {
	qcom, = <24>;
	/* #4917649_300mah_averaged_masterslave_jan5th2021*/
	qcom,max-voltage-uv = <4450000>;
	qcom,fg-cc-cv-threshold-mv = <4440>;
	qcom,fastchg-current-ma = <300>;
	qcom,nom-batt-capacity-mah = <300>;
	/* add another jeita setting for 2nd battery*/
	qcom,bp-jeita-soft-hot-fv-cc = <4200 150>;
	qcom,bp-jeita-soft-cold-fv-cc = <4400 60>;
	qcom,batt-id-kohm = <60>;
	qcom,battery-beta = <4250>;
	qcom,battery-type = "4917649_300mah_averaged_masterslave_jan5th2021";
	qcom,checksum = <0xFADC>;
	qcom,gui-version = "PM660GUI - 0.0.0.45";
	qcom,fg-profile-data = [
		 A2 20 80 04
		 47 0B 88 05
		 D8 1C AD 01
		 1F 05 42 03
		 88 18 2D 22
		 54 3D 45 4A
		 8C 00 00 00
		 19 00 00 00
		 00 00 71 B5
		 64 C4 27 C3
		 1F 00 08 00
		 7C C2 5A E4
		 09 FD 37 F3
		 CD 04 F3 FA
		 62 D5 C8 12
		 3F 06 09 20
		 27 00 14 00
		 C2 21 B3 0D
		 0A 12 C6 04
		 DE 1C 2D 02
		 CF 0D 40 0A
		 BD 18 71 22
		 8A 3C 6A 4B
		 8A 00 00 00
		 15 00 00 00
		 00 00 D8 C2
		 97 D5 C7 CB
		 19 00 00 00
		 93 EB 5A E4
		 02 F4 74 EA
		 11 D4 86 03
		 2D F3 35 13
		 99 33 CC FF
		 07 10 00 00
		 2B 01 33 47
		 19 00 40 00
		 64 07 0A FA
		 FF 00 00 00
		 00 00 00 00
		 00 00 00 00
		 00 00 00 00
		 00 00 00 00
		 00 00 00 00
		 00 00 00 00
		 00 00 00 00
		 00 00 00 00
		 00 00 00 00
		 00 00 00 00
		 00 00 00 00
		 00 00 00 00
		 00 00 00 00
		 00 00 00 00
		 00 00 00 00
		 00 00 00 00
		 00 00 00 00
		 00 00 00 00
	];
};
